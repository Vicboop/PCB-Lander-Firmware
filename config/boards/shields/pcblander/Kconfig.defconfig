## config/boards/shields/pcblander/Kconfig.defconfig
```kconfig
if SHIELD_PCBLANDER_LEFT || SHIELD_PCBLANDER_RIGHT

config ZMK_KEYBOARD_NAME
    default "PCBLander"

config ZMK_STUDIO_LAYOUT_SELECTION
    bool
    default y

endif
```

## config/boards/shields/pcblander/Kconfig.shield
```kconfig
config SHIELD_PCBLANDER_LEFT
    def_bool $(shields_list_contains,pcblander_left)
    select ZMK_STUDIO_LAYOUT_SELECTION

config SHIELD_PCBLANDER_RIGHT
    def_bool $(shields_list_contains,pcblander_right)
    select ZMK_STUDIO_LAYOUT_SELECTION
```
